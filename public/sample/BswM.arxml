AUTOSAR XML (schema 00048)
package /RK2118M2
  module config BswM
    BswMGeneral:
      BswMCanSMEnabled = true
      BswMCanSMIcomEnabled = false
      BswMComMEnabled = true
      BswMComMPncEnabled = false
      BswMDcmEnabled = true
      BswMDevErrorDetect = false
      BswMEcuMEnabled = true
      BswMEthSMEnabled = false
      BswMFrSMEnabled = false
      BswMGenericRequestEnabled = true
      BswMJ1939DcmEnabled = false
      BswMJ1939NmEnabled = false
      BswMLinSMEnabled = false
      BswMLinTPEnabled = false
      BswMNmEnabled = true
      BswMNvMEnabled = true
      BswMSchMEnabled = false
      BswMSdEnabled = false
      BswMVersionInfoApi = false
      BswMWdgMEnabled = false
      BswMTimerEnabled = true
      BswMMainFunctionPeriod = 0.01
      BswMUserIncludeFiles: BswMUserIncludeFile=BswM_User_Callout.h
    BswMConfig
      BswMArbitration
        BswMModeInitValue: BswMCanSMIndicationInitState=CANSM_BSWM_NO_COMMUNICATION, BswMEcuMWakeupSourceInitstate=ECUM_WKSTATUS_NONE, BswMGenericRequestInitMode=255
        5 x BswMModeRequestPort, all with BswMRequestProcessing=BSWM_IMMEDIATE:
          RPort_EcuMIndi
            BswMModeRequestSource
              BswMEcuMIndication
          RPort_Wks_Can1
            BswMModeRequestSource
              BswMEcuMWakeupSource: BswMEcuMWakeupSrcRef=WKUP_CAN
          RPort_CanSMIndi_Can1
            BswMModeRequestSource
              BswMCanSMIndication: BswMCanSMChannelRef=ComMChannel_0
          RPort_DcmIndi
            BswMModeRequestSource
              BswMDcmComModeRequest: BswMDcmComMChannelRef=ComMChannel_0
          RPort_CanNMIndi_1
            BswMModeRequestSource
              BswMGenericRequest: BswMModeRequesterId=1
        Rule_SartUp (BswMRule): BswMNestedExecutionOnly=false, BswMRuleInitState=BSWM_UNDEFINED, BswMRuleExpressionRef=LE_SartUp, BswMRuleTrueActionList=AL_SartUp
        10 x BswMLogicalExpression:
          LE_SartUp: BswMArgumentRef=Cond_EcuMIndi_SartUp
          LE_GoDown: BswMLogicalOperator=BSWM_AND, BswMArgumentRef=Cond_Wks_None_Can1, BswMArgumentRef=Cond_CanSMIndi_NoCom_Can1, BswMArgumentRef=Cond_CanNMIndi_AllowedSleep
          LE_ClearWakeupEvent_Validated: BswMLogicalOperator=BSWM_AND, BswMArgumentRef=Cond_Wks_Validated_Can1, BswMArgumentRef=Cond_CanSMIndi_FullCom_Can1
          LE_ClearWakeupEvent: BswMLogicalOperator=BSWM_OR, BswMArgumentRef=Cond_Wks_Expired_Can1, BswMArgumentRef=LE_ClearWakeupEvent_Validated
          LE_DisTx_PduGroup: BswMLogicalOperator=BSWM_OR, BswMArgumentRef=Cond_DcmIndi_DisTx_EnRx_Norm, BswMArgumentRef=Cond_DcmIndi_DisTx_DisRx_Norm, BswMArgumentRef=Cond_DcmIndi_DisTx_EnRx_All, BswMArgumentRef=Cond_DcmIndi_DisTx_DisRx_All
          LE_DisRx_PduGroup: BswMLogicalOperator=BSWM_OR, BswMArgumentRef=Cond_DcmIndi_DisTx_DisRx_Norm, BswMArgumentRef=Cond_DcmIndi_EnTx_DisRx_Norm, BswMArgumentRef=Cond_DcmIndi_EnTx_DisRx_All, BswMArgumentRef=Cond_DcmIndi_DisTx_DisRx_All
          LE_EnTx_PduGroup: BswMLogicalOperator=BSWM_OR, BswMArgumentRef=Cond_DcmIndi_EnTx_EnRx_Norm, BswMArgumentRef=Cond_DcmIndi_EnTx_DisRx_Norm, BswMArgumentRef=Cond_DcmIndi_EnTx_EnRx_All, BswMArgumentRef=Cond_DcmIndi_EnTx_DisRx_All
          LE_EnRx_PduGroup: BswMLogicalOperator=BSWM_OR, BswMArgumentRef=Cond_DcmIndi_EnTx_EnRx_Norm, BswMArgumentRef=Cond_DcmIndi_DisTx_EnRx_Norm, BswMArgumentRef=Cond_DcmIndi_EnTx_EnRx_All, BswMArgumentRef=Cond_DcmIndi_DisTx_EnRx_All
          LE_Dis_NM: BswMLogicalOperator=BSWM_OR, BswMArgumentRef=Cond_DcmIndi_DisTx_EnRx_All, BswMArgumentRef=Cond_DcmIndi_DisTx_DisRx_All, BswMArgumentRef=Cond_DcmIndi_DisTx_EnRx_Nm, BswMArgumentRef=Cond_DcmIndi_DisTx_DisRx_Nm
          LE_En_NM: BswMLogicalOperator=BSWM_OR, BswMArgumentRef=Cond_DcmIndi_EnTx_EnRx_All, BswMArgumentRef=Cond_DcmIndi_EnTx_DisRx_All, BswMArgumentRef=Cond_DcmIndi_EnTx_EnRx_Nm, BswMArgumentRef=Cond_DcmIndi_EnTx_DisRx_Nm
        8 x BswMRule, all with BswMNestedExecutionOnly=false, BswMRuleInitState=BSWM_UNDEFINED:
          Rule_GoDown: BswMRuleExpressionRef=LE_GoDown, BswMRuleTrueActionList=AL_GoDown
          Rule_ClearWakeupEvent: BswMRuleExpressionRef=LE_ClearWakeupEvent, BswMRuleTrueActionList=AL_ClearWakeupEvent
          Rule_DisTx_PduGroup: BswMRuleExpressionRef=LE_DisTx_PduGroup, BswMRuleTrueActionList=AL_DisTx_PduGroup_Can1
          Rule_DisRx_PduGroup: BswMRuleExpressionRef=LE_DisRx_PduGroup, BswMRuleTrueActionList=AL_DisRx_PduGroup_Can1
          Rule_EnTx_PduGroup: BswMRuleExpressionRef=LE_EnTx_PduGroup, BswMRuleTrueActionList=AL_EnTx_PduGroup_Can1
          Rule_EnRx_PduGroup: BswMRuleExpressionRef=LE_EnRx_PduGroup, BswMRuleTrueActionList=AL_EnRx_PduGroup_Can1
          Rule_Dis_NM: BswMRuleExpressionRef=LE_Dis_NM, BswMRuleTrueActionList=AL_Dis_NM
          Rule_En_NM: BswMRuleExpressionRef=LE_En_NM, BswMRuleTrueActionList=AL_En_NM
        23 x BswMModeCondition, all with BswMConditionType=BSWM_EQUALS:
          Cond_EcuMIndi_SartUp: BswMConditionMode=RPort_EcuMIndi
            BswMConditionValue
              BswMBswMode: BswModeCompareValue=ECUM_STATE_STARTUP
          Cond_EcuMIndi_ShutDown: BswMConditionMode=RPort_EcuMIndi
            BswMConditionValue
              BswMBswMode: BswModeCompareValue=ECUM_STATE_SHUTDOWN
          Cond_Wks_None_Can1: BswMConditionMode=RPort_Wks_Can1
            BswMConditionValue
              BswMBswMode: BswModeCompareValue=ECUM_WKSTATUS_NONE
          Cond_Wks_Validated_Can1: BswMConditionMode=RPort_Wks_Can1
            BswMConditionValue
              BswMBswMode: BswModeCompareValue=ECUM_WKSTATUS_VALIDATED
          Cond_Wks_Expired_Can1: BswMConditionMode=RPort_Wks_Can1
            BswMConditionValue
              BswMBswMode: BswModeCompareValue=ECUM_WKSTATUS_EXPIRED
          Cond_CanSMIndi_NoCom_Can1: BswMConditionMode=RPort_CanSMIndi_Can1
            BswMConditionValue
              BswMBswMode: BswModeCompareValue=CANSM_BSWM_NO_COMMUNICATION
          Cond_CanSMIndi_SilentCom_Can1: BswMConditionMode=RPort_CanSMIndi_Can1
            BswMConditionValue
              BswMBswMode: BswModeCompareValue=CANSM_BSWM_SILENT_COMMUNICATION
          Cond_CanSMIndi_FullCom_Can1: BswMConditionMode=RPort_CanSMIndi_Can1
            BswMConditionValue
              BswMBswMode: BswModeCompareValue=CANSM_BSWM_FULL_COMMUNICATION
          Cond_CanSMIndi_BusOff_Can1: BswMConditionMode=RPort_CanSMIndi_Can1
            BswMConditionValue
              BswMBswMode: BswModeCompareValue=CANSM_BSWM_BUS_OFF
          Cond_DcmIndi_EnTx_EnRx_Norm: BswMConditionMode=RPort_DcmIndi
            BswMConditionValue
              BswMBswMode: BswModeCompareValue=DCM_ENABLE_RX_TX_NORM
          Cond_DcmIndi_EnTx_DisRx_Norm: BswMConditionMode=RPort_DcmIndi
            BswMConditionValue
              BswMBswMode: BswModeCompareValue=DCM_DISABLE_RX_ENABLE_TX_NORM
          Cond_DcmIndi_DisTx_EnRx_Norm: BswMConditionMode=RPort_DcmIndi
            BswMConditionValue
              BswMBswMode: BswModeCompareValue=DCM_ENABLE_RX_DISABLE_TX_NORM
          Cond_DcmIndi_DisTx_DisRx_Norm: BswMConditionMode=RPort_DcmIndi
            BswMConditionValue
              BswMBswMode: BswModeCompareValue=DCM_DISABLE_RX_TX_NORMAL
          Cond_DcmIndi_EnTx_EnRx_Nm: BswMConditionMode=RPort_DcmIndi
            BswMConditionValue
              BswMBswMode: BswModeCompareValue=DCM_ENABLE_RX_TX_NM
          Cond_DcmIndi_EnTx_DisRx_Nm: BswMConditionMode=RPort_DcmIndi
            BswMConditionValue
              BswMBswMode: BswModeCompareValue=DCM_DISABLE_RX_ENABLE_TX_NM
          Cond_DcmIndi_DisTx_EnRx_Nm: BswMConditionMode=RPort_DcmIndi
            BswMConditionValue
              BswMBswMode: BswModeCompareValue=DCM_ENABLE_RX_DISABLE_TX_NM
          Cond_DcmIndi_DisTx_DisRx_Nm: BswMConditionMode=RPort_DcmIndi
            BswMConditionValue
              BswMBswMode: BswModeCompareValue=DCM_DISABLE_RX_TX_NM
          Cond_DcmIndi_EnTx_EnRx_All: BswMConditionMode=RPort_DcmIndi
            BswMConditionValue
              BswMBswMode: BswModeCompareValue=DCM_ENABLE_RX_TX_NORM_NM
          Cond_DcmIndi_EnTx_DisRx_All: BswMConditionMode=RPort_DcmIndi
            BswMConditionValue
              BswMBswMode: BswModeCompareValue=DCM_DISABLE_RX_ENABLE_TX_NORM_NM
          Cond_DcmIndi_DisTx_EnRx_All: BswMConditionMode=RPort_DcmIndi
            BswMConditionValue
              BswMBswMode: BswModeCompareValue=DCM_ENABLE_RX_DISABLE_TX_NORM_NM
          Cond_DcmIndi_DisTx_DisRx_All: BswMConditionMode=RPort_DcmIndi
            BswMConditionValue
              BswMBswMode: BswModeCompareValue=DCM_DISABLE_RX_TX_NORM_NM
          Cond_CanNMIndi_NoAllowedSleep: BswMConditionMode=RPort_CanNMIndi_1
            BswMConditionValue
              BswMBswMode: BswMBswRequestedMode=COND_NM_NOALLOWED_SLEEP
          Cond_CanNMIndi_AllowedSleep: BswMConditionMode=RPort_CanNMIndi_1
            BswMConditionValue
              BswMBswMode: BswMBswRequestedMode=COND_NM_ALLOWED_SLEEP
        5 x BswMLogicalExpression:
          LE_CanSMIndi_NoCom_Can1: BswMArgumentRef=Cond_CanSMIndi_NoCom_Can1
          LE_CanSMIndi_SilentCom_Can1: BswMLogicalOperator=BSWM_AND, BswMArgumentRef=Cond_CanSMIndi_SilentCom_Can1, BswMArgumentRef=Cond_PowerIndi_Voltage_Normal
          LE_CanSMIndi_FullCom_Can1_EnTxRx: BswMLogicalOperator=BSWM_AND, BswMArgumentRef=Cond_DcmIndi_EnTx_EnRx_Norm, BswMArgumentRef=Cond_DcmIndi_EnTx_EnRx_All
          LE_CanSMIndi_FullCom_Can1: BswMLogicalOperator=BSWM_OR, BswMArgumentRef=Cond_CanSMIndi_FullCom_Can1, BswMArgumentRef=LE_CanSMIndi_FullCom_Can1_EnTxRx
          LE_CanSMIndi_BusOff_Can1: BswMArgumentRef=Cond_CanSMIndi_BusOff_Can1
        6 x BswMRule, all with BswMNestedExecutionOnly=false, BswMRuleInitState=BSWM_UNDEFINED:
          Rule_CanSMIndi_NoCom_Can1: BswMRuleExpressionRef=LE_CanSMIndi_NoCom_Can1, BswMRuleTrueActionList=AL_CanSMIndi_NoCom_Can1
          Rule_CanSMIndi_SilentCom_Can1: BswMRuleExpressionRef=LE_CanSMIndi_SilentCom_Can1, BswMRuleTrueActionList=AL_CanSMIndi_SilentCom_Can1
          Rule_CanSMIndi_FullCom_Can1: BswMRuleExpressionRef=LE_CanSMIndi_FullCom_Can1_Voltage, BswMRuleTrueActionList=AL_CanSMIndi_FullCom_Can1
          Rule_CanSMIndi_BusOff_Can1: BswMRuleExpressionRef=LE_CanSMIndi_BusOff_Can1, BswMRuleTrueActionList=AL_CanSMIndi_BusOff_Can1
          Rule_PowerIndi_Voltage_Abnormal: BswMRuleExpressionRef=LE_PowerIndi_Voltage_Abnormal, BswMRuleTrueActionList=AL_PowerIndi_Voltage_Abnormal
          Rule_PowerIndi_Voltage_Normal: BswMRuleExpressionRef=LE_PowerIndi_Voltage_Normal, BswMRuleTrueActionList=AL_PowerIndi_Voltage_Normal
        LE_PowerIndi_Voltage_Normal (BswMLogicalExpression): BswMLogicalOperator=BSWM_AND, BswMArgumentRef=Cond_CanSMIndi_FullCom_Can1, BswMArgumentRef=Cond_PowerIndi_Voltage_Normal
        Cond_PowerIndi_Voltage_Normal (BswMModeCondition): BswMConditionType=BSWM_EQUALS, BswMConditionMode=RPort_PowerIndi_2
          BswMConditionValue
            BswMBswMode: BswMBswRequestedMode=COND_POWER_VOLTAGE_NORMAL
        RPort_PowerIndi_2 (BswMModeRequestPort): BswMRequestProcessing=BSWM_IMMEDIATE
          BswMModeRequestSource
            BswMGenericRequest: BswMModeRequesterId=2
        Cond_PowerIndi_Voltage_Under (BswMModeCondition): BswMConditionType=BSWM_EQUALS, BswMConditionMode=RPort_PowerIndi_2
          BswMConditionValue
            BswMBswMode: BswMBswRequestedMode=COND_POWER_VOLTAGE_UNDER
        Cond_PowerIndi_Voltage_Over (BswMModeCondition): BswMConditionType=BSWM_EQUALS, BswMConditionMode=RPort_PowerIndi_2
          BswMConditionValue
            BswMBswMode: BswMBswRequestedMode=COND_POWER_VOLTAGE_OVER
        LE_PowerIndi_Voltage_Abnormal (BswMLogicalExpression): BswMLogicalOperator=BSWM_OR, BswMArgumentRef=Cond_PowerIndi_Voltage_Under, BswMArgumentRef=Cond_PowerIndi_Voltage_Over
        LE_CanSMIndi_FullCom_Can1_Voltage (BswMLogicalExpression): BswMLogicalOperator=BSWM_AND, BswMArgumentRef=LE_CanSMIndi_FullCom_Can1, BswMArgumentRef=Cond_PowerIndi_Voltage_Normal
      BswMModeControl
        19 x BswMAction:
          Act_InitBSW
            BswMAvailableActions
              BswMEcuMDriverInitListBswM: BswMEcuMDriverInitListBswMRef=EcuMDriverInitListBswM_0
          Act_EcuMGoDown
            BswMAvailableActions
              BswMEcuMGoDownHaltPoll: BswMEcuMUserIdRef=EcuMFlexUserConfig
          Act_ClearWakeupEvent
            BswMAvailableActions
              BswMUserCallout: BswMUserCalloutFunction=Act_ClearWakeupEvent
          Act_ComM_Allow_Can1
            BswMAvailableActions
              BswMComMAllowCom: BswMComAllowed=true, BswMComMAllowChannelRef=ComMChannel_0
          Act_ComM_DisAllow_Can1
            BswMAvailableActions
              BswMComMAllowCom: BswMComAllowed=false, BswMComMAllowChannelRef=ComMChannel_0
          Act_ComM_ReqFullCom_Can1
            BswMAvailableActions
              BswMComMModeSwitch: BswMComMRequestedMode=COMM_FULL_COMMUNICATION, BswMComMUserRef=ComMUser_0
          Act_ComM_ReqNoCom_Can1
            BswMAvailableActions
              BswMComMModeSwitch: BswMComMRequestedMode=COMM_NO_COMMUNICATION, BswMComMUserRef=ComMUser_0
          Act_Reinit_EnTx_PduGroup_Can1
            BswMAvailableActions
              BswMPduGroupSwitch: BswMPduGroupSwitchReinit=true, BswMEnabledPduGroupRef=Com_TxPduGroup_CONTROLLER_0_AMP
          Act_Reinit_EnRx_PduGroup_Can1
            BswMAvailableActions
              BswMPduGroupSwitch: BswMPduGroupSwitchReinit=true, BswMEnabledPduGroupRef=Com_RxPduGroup_CONTROLLER_0_AMP
          Act_DisTx_PduGroup_Can1
            BswMAvailableActions
              BswMPduGroupSwitch: BswMPduGroupSwitchReinit=false, BswMDisabledPduGroupRef=Com_TxPduGroup_CONTROLLER_0_AMP
          Act_DisRx_PduGroup_Can1
            BswMAvailableActions
              BswMPduGroupSwitch: BswMPduGroupSwitchReinit=false, BswMDisabledPduGroupRef=Com_RxPduGroup_CONTROLLER_0_AMP
          Act_EnTx_PduGroup_Can1
            BswMAvailableActions
              BswMPduGroupSwitch: BswMPduGroupSwitchReinit=false, BswMEnabledPduGroupRef=Com_TxPduGroup_CONTROLLER_0_AMP
          Act_EnRx_PduGroup_Can1
            BswMAvailableActions
              BswMPduGroupSwitch: BswMPduGroupSwitchReinit=false, BswMEnabledPduGroupRef=Com_RxPduGroup_CONTROLLER_0_AMP
          Act_DisDMTx_PduGroup_Can1
            BswMAvailableActions
              BswMDeadlineMonitoringControl: BswMDisabledDMPduGroupRef=Com_TxPduGroup_CONTROLLER_0_AMP
          Act_DisDMRx_PduGroup_Can1
            BswMAvailableActions
              BswMDeadlineMonitoringControl: BswMDisabledDMPduGroupRef=Com_RxPduGroup_CONTROLLER_0_AMP
          Act_EnDMTx_PduGroup_Can1
            BswMAvailableActions
              BswMDeadlineMonitoringControl: BswMEnabledDMPduGroupRef=Com_TxPduGroup_CONTROLLER_0_AMP
          Act_EnDMRx_PduGroup_Can1
            BswMAvailableActions
              BswMDeadlineMonitoringControl: BswMEnabledDMPduGroupRef=Com_RxPduGroup_CONTROLLER_0_AMP
          Act_Dis_NM
            BswMAvailableActions
              BswMNMControl: BswMNMAction=BSWM_NM_DISABLE, BswMComMNetworkHandleRef=ComMChannel_0
          Act_En_NM
            BswMAvailableActions
              BswMNMControl: BswMNMAction=BSWM_NM_ENABLE, BswMComMNetworkHandleRef=ComMChannel_0
        17 x BswMActionList, all with BswMActionListExecution=BSWM_TRIGGER:
          AL_SartUp
            6 x BswMActionListItem, all with BswMAbortOnFail=false:
              Item_Act_InitBSW: BswMActionListItemIndex=0, BswMActionListItemRef=Act_InitBSW
              Item_Act_ComM_Allow_Can1: BswMActionListItemIndex=1, BswMActionListItemRef=Act_ComM_Allow_Can1
              Item_Act_Reinit_EnTx_PduGroup_Can1: BswMActionListItemIndex=2, BswMActionListItemRef=Act_Reinit_EnTx_PduGroup_Can1
              Item_Act_Reinit_EnRx_PduGroup_Can1: BswMActionListItemIndex=3, BswMActionListItemRef=Act_Reinit_EnRx_PduGroup_Can1
              Item_Act_DisTx_PduGroup_Can1: BswMActionListItemIndex=4, BswMActionListItemRef=Act_DisTx_PduGroup_Can1
              Item_Act_DisRx_PduGroup_Can1: BswMActionListItemIndex=5, BswMActionListItemRef=Act_DisRx_PduGroup_Can1
          AL_GoDown
            Item_Act_EcuMGoDown (BswMActionListItem): BswMAbortOnFail=false, BswMActionListItemIndex=0, BswMActionListItemRef=Act_EcuMGoDown
          AL_ClearWakeupEvent
            Item_Act_ClearWakeupEvent (BswMActionListItem): BswMAbortOnFail=false, BswMActionListItemIndex=0, BswMActionListItemRef=Act_ClearWakeupEvent
          AL_KL15_ON_ComM_ReqFullCom
            Item_Act_ComM_ReqFullCom_Can1 (BswMActionListItem): BswMAbortOnFail=false, BswMActionListItemIndex=0, BswMActionListItemRef=Act_ComM_ReqFullCom_Can1
          AL_KL15_OFF_ComM_ReqNoCom
            Item_Act_ComM_ReqNoCom_Can1 (BswMActionListItem): BswMAbortOnFail=false, BswMActionListItemIndex=0, BswMActionListItemRef=Act_ComM_ReqNoCom_Can1
          AL_DisTx_PduGroup_Can1
            Item_Act_DisTx_PduGroup_Can1 (BswMActionListItem): BswMAbortOnFail=false, BswMActionListItemIndex=0, BswMActionListItemRef=Act_DisTx_PduGroup_Can1
            Item_Act_DisDMTx_PduGroup_Can1 (BswMActionListItem): BswMAbortOnFail=false, BswMActionListItemIndex=1, BswMActionListItemRef=Act_DisDMTx_PduGroup_Can1
          AL_DisRx_PduGroup_Can1
            Item_Act_DisRx_PduGroup_Can1 (BswMActionListItem): BswMAbortOnFail=false, BswMActionListItemIndex=0, BswMActionListItemRef=Act_DisRx_PduGroup_Can1
            Item_Act_DisDMRx_PduGroup_Can1 (BswMActionListItem): BswMAbortOnFail=false, BswMActionListItemIndex=1, BswMActionListItemRef=Act_DisDMRx_PduGroup_Can1
          AL_EnTx_PduGroup_Can1
            Item_Act_EnTx_PduGroup_Can1 (BswMActionListItem): BswMAbortOnFail=false, BswMActionListItemIndex=0, BswMActionListItemRef=Act_EnTx_PduGroup_Can1
            Item_Act_EnDMTx_PduGroup_Can1 (BswMActionListItem): BswMAbortOnFail=false, BswMActionListItemIndex=1, BswMActionListItemRef=Act_EnDMTx_PduGroup_Can1
          AL_EnRx_PduGroup_Can1
            Item_Act_EnRx_PduGroup_Can1 (BswMActionListItem): BswMAbortOnFail=false, BswMActionListItemIndex=0, BswMActionListItemRef=Act_EnRx_PduGroup_Can1
            Item_Act_EnDMRx_PduGroup_Can1 (BswMActionListItem): BswMAbortOnFail=false, BswMActionListItemIndex=1, BswMActionListItemRef=Act_EnDMRx_PduGroup_Can1
          AL_Dis_NM
            Item_Act_Dis_NM (BswMActionListItem): BswMAbortOnFail=false, BswMActionListItemIndex=0, BswMActionListItemRef=Act_Dis_NM
          AL_En_NM
            Item_Act_En_NM (BswMActionListItem): BswMAbortOnFail=false, BswMActionListItemIndex=0, BswMActionListItemRef=Act_En_NM
          AL_CanSMIndi_NoCom_Can1
            3 x BswMActionListItem, all with BswMAbortOnFail=false:
              Item_AL_DisTx_PduGroup_Can1: BswMActionListItemIndex=0, BswMActionListItemRef=AL_DisTx_PduGroup_Can1
              Item_AL_DisRx_PduGroup_Can1: BswMActionListItemIndex=1, BswMActionListItemRef=AL_DisRx_PduGroup_Can1
              Item_Act_Dis_PduRouter_Diag: BswMActionListItemIndex=2, BswMActionListItemRef=Act_Dis_PduRouter_Diag
          AL_CanSMIndi_SilentCom_Can1
            3 x BswMActionListItem, all with BswMAbortOnFail=false:
              Item_AL_DisTx_PduGroup_Can1: BswMActionListItemIndex=0, BswMActionListItemRef=AL_DisTx_PduGroup_Can1
              Item_AL_EnRx_PduGroup_Can1: BswMActionListItemIndex=1, BswMActionListItemRef=AL_EnRx_PduGroup_Can1
              Item_Act_Dis_PduRouter_Diag: BswMActionListItemIndex=2, BswMActionListItemRef=Act_Dis_PduRouter_Diag
          AL_CanSMIndi_FullCom_Can1
            3 x BswMActionListItem, all with BswMAbortOnFail=false:
              Item_AL_EnTx_PduGroup_Can1: BswMActionListItemIndex=0, BswMActionListItemRef=AL_EnTx_PduGroup_Can1
              Item_AL_EnRx_PduGroup_Can1: BswMActionListItemIndex=1, BswMActionListItemRef=AL_EnRx_PduGroup_Can1
              Item_Act_En_PduRouter_Diag: BswMActionListItemIndex=2, BswMActionListItemRef=Act_En_PduRouter_Diag
          AL_CanSMIndi_BusOff_Can1
            Item_AL_DisTx_PduGroup_Can1 (BswMActionListItem): BswMAbortOnFail=false, BswMActionListItemIndex=0, BswMActionListItemRef=AL_DisTx_PduGroup_Can1
            Item_AL_DisRx_PduGroup_Can1 (BswMActionListItem): BswMAbortOnFail=false, BswMActionListItemIndex=1, BswMActionListItemRef=AL_DisRx_PduGroup_Can1
          AL_PowerIndi_Voltage_Abnormal
            4 x BswMActionListItem, all with BswMAbortOnFail=false:
              Item_AL_DisTx_PduGroup: BswMActionListItemIndex=0, BswMActionListItemRef=Act_DisTx_PduGroup_Can1
              Item_AL_DisRx_PduGroup: BswMActionListItemIndex=1, BswMActionListItemRef=Act_DisRx_PduGroup_Can1
              Item_Act_Dis_NM: BswMActionListItemIndex=2, BswMActionListItemRef=Act_Dis_NM
              Item_Act_Dis_PduRouter_Diag: BswMActionListItemIndex=3, BswMActionListItemRef=Act_Dis_PduRouter_Diag
          AL_PowerIndi_Voltage_Normal
            4 x BswMActionListItem, all with BswMAbortOnFail=false:
              Item_AL_EnTx_PduGroup: BswMActionListItemIndex=0, BswMActionListItemRef=Act_EnTx_PduGroup_Can1
              Item_AL_EnRx_PduGroup: BswMActionListItemIndex=1, BswMActionListItemRef=Act_EnRx_PduGroup_Can1
              Item_Act_En_NM: BswMActionListItemIndex=2, BswMActionListItemRef=Act_En_NM
              Item_Act_En_PduRouter_Diag: BswMActionListItemIndex=3, BswMActionListItemRef=Act_En_PduRouter_Diag
        Act_Dis_PduRouter_Diag (BswMAction)
          BswMAvailableActions
            BswMPduRouterControl: BswMPduRouterAction=BSWM_PDUR_DISABLE, BswMPduRouterDisableInitBuffer=false, BswMPduRoutingPathGroupRef=PduRRoutingPathGroup_Diag
        Act_En_PduRouter_Diag (BswMAction)
          BswMAvailableActions
            BswMPduRouterControl: BswMPduRouterAction=BSWM_PDUR_ENABLE, BswMPduRoutingPathGroupRef=PduRRoutingPathGroup_Diag
